## boards/shields/askkb/Kconfig.defconfig
```kconfig
# Copyright (c) 2024 The ZMK Contributors
# SPDX-License-Identifier: MIT

if SHIELD_ASKKB

config ZMK_KEYBOARD_NAME
    default "askkb"

endif
```

## boards/shields/askkb/Kconfig.shield
```kconfig
# Copyright (c) 2024 The ZMK Contributors
# SPDX-License-Identifier: MIT

config SHIELD_ASKKB
    def_bool $(shields_list_contains,askkb)
```

## boards/shields/hskb/Kconfig.defconfig
```kconfig
# Copyright (c) 2021 The ZMK Contributors
# SPDX-License-Identifier: MIT

if SHIELD_HSKB

config ZMK_KEYBOARD_NAME
    default "HSKB"

endif
```

## boards/shields/hskb/Kconfig.shield
```kconfig
# Copyright (c) 2021 The ZMK Contributors
# SPDX-License-Identifier: MIT

config SHIELD_HSKB
    def_bool $(shields_list_contains,hskb)
```
