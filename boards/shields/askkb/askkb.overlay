/*
*
* Copyright (c) 2024 Rafael Romão
* SPDX-License-Identifier: MIT
*
*/

#include <dt-bindings/zmk/matrix_transform.h>

/ {
    chosen {
        zmk,kscan = &kscan0;
        zmk,matrix_transform = &default_transform;
        /delete-property/ zephyr,console;
        /delete-property/ zephyr,shell-uart;
    };

    default_transform: keymap_transform_0 {
        compatible = "zmk,matrix-transform";
        columns = <1>;
        rows = <1>;
        map = <
        RC(0,0)
        >;
    };


    kscan0: kscan {
        compatible = "zmk,kscan-gpio-direct";
        input-gpios
            = <&gpio0 8 (GPIO_ACTIVE_LOW | GPIO_PULL_UP)>
            ;
    };

};